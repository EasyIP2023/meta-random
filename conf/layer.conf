## conf/layer.conf
```bitbake
# We have a conf and classes directory, add to BBPATH
BBPATH .= ":${LAYERDIR}"

# We have recipes-* directories, add to BBFILES
BBFILES += "${LAYERDIR}/recipes-*/*/*.bb \
            ${LAYERDIR}/recipes-*/*/*.bbappend"

BBFILE_COLLECTIONS += "meta-random"
BBFILE_PATTERN_meta-random = "^${LAYERDIR}/"
BBFILE_PRIORITY_meta-random = "6"

LAYERDEPENDS_meta-random = "core"
LAYERSERIES_COMPAT_meta-random = "dunfell"
```
